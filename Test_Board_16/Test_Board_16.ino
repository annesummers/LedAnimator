#include <Tlc5940.h>
#include <tlc_animations.h>
#include <tlc_config.h>
#include <tlc_fades.h>
#include <tlc_progmem_utils.h>
#include <tlc_servos.h>
#include <tlc_shifts.h>

#include <avr/pgmspace.h>

boolean gHaveCode;

PROGMEM prog_uint16_t gammaCorrection[] = {
  0,
  0, 0, 0, 0, 1, 1, 1, 2, 3, 3, 4, 5, 6, 7, 8, 9,11,12,13,15,
  17,19,21,23,25,27,29,32,34,37,40,42,45,48,52,55,58,62,
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  3872,3906,3941,3975,4010,4045,4080};

PROGMEM prog_uchar animation1[] = {
86,
16,0,
1,
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172,69};
  
int ledMapping[][3] = {  
  { 41, 43, 42 },  { 22, 24, 23 },  { 19, 21, 20 },  { 16, 18, 17 }, 
  
  { 44, 46, 45 }, { 38, 40, 39  }, { 25, 27, 26 }, { 28, 30, 29 }, 
  
  { 32, 34, 33  }, { 0, 47, 31  }, { 4, 6, 5 }, { 1, 3, 2  },    
  
  { 35, 37, 36  },  { 7, 9, 8 }, { 10, 12, 11 }, { 13, 15, 14 }
};
  
struct animation {
  int numLeds;
  int numFrames;
  int frameFrequency;
} typedef Animation;

Animation anim;

void setup() {
  Serial.begin(9600);
  //Serial.print("woo");
  //Serial.print("\n");

  Tlc.init();
  Tlc.clear();
  Tlc.update();

  Serial.print("woo");
  Serial.print("\n");

  gHaveCode = true;
}

void loop() {
  if(gHaveCode) {
    int next = 0;
    unsigned int val;
    int k;    // counter variable

    readAnimation(&next);

    next = 0;
  } else {
    testLoop();
  }
}

void readAnimation(int* nextByte) {
  unsigned char header = readByteProgmem(nextByte);
    Serial.print("header is ");
   Serial.print(header, HEX);
    Serial.print("\n");
    
    byte numLedsHigh = readByteProgmem(nextByte);
    byte numLedsLow = readByteProgmem(nextByte);
    anim.numLeds = numLedsHigh |= numLedsLow << 8;
    //anim.numLeds = readByteProgmem(nextByte);
    readByteProgmem(nextByte);
    readByteProgmem(nextByte);
    anim.numFrames = readByteProgmem(nextByte);
    anim.frameFrequency = readByteProgmem(nextByte);
    
    unsigned int frame = 0;
    int framecounter = 0;
    while(framecounter++ < anim.numFrames) {
      Serial.print("frame ");
     Serial.print(framecounter, DEC);
      Serial.print("\n");

      unsigned char led = 0;
      int ledcounter = 0;

      while(ledcounter < anim.numLeds){
        Serial.print("led ");
        Serial.print(ledcounter, DEC);
        Serial.print("\n");

        readAndSetColour(nextByte, ledcounter++);
      }

      Tlc.update();
      delay(anim.frameFrequency);
    }
    //unsigned char ledRows = readByteProgmem(&next);
    //Serial.print("led rows are ");
    //Serial.print(ledRows, DEC);
   // Serial.print("\n");
    
    //unsigned char ledColumns = readByteProgmem(&next);
   // Serial.print("led columns are ");
   // Serial.print(ledColumns, DEC);
   // Serial.print("\n");
    
   // unsigned int ledCount = ledColumns*ledRows;

   // unsigned char frameCount = readByteProgmem(&next);
   // Serial.print("frame count is ");
   // Serial.print(frameCount, DEC);
   // Serial.print("\n");

 // unsigned char frameFrequency = readByteProgmem(&next);
}

void testLoop() {
  for(int i = 0; i < 16; i++) {
     // setColour(i, 256, 256, 256);
       
       //Tlc.update();
      Serial.print(i, DEC);
       
       delay(500);
       setColour(i, 256, 0, 0);
       
       Tlc.update();
       
       delay(500);        
       
       setColour(i, 0, 256, 0);
       
       Tlc.update();
       
       delay(500);        
       
       setColour(i, 0, 0, 256);
       
       Tlc.update();
       
       delay(500);
       
       setColour(i, 256, 256, 256);
       
       Tlc.update();
    }
}

void readAndSetColour(int* aPosition, unsigned char aLed)
{
  /*Serial.print("next is ");
   Serial.print(*aPosition, DEC);
   Serial.print("\n");*/

  unsigned char red = readByteProgmem(aPosition);
  unsigned char green = readByteProgmem(aPosition);
  unsigned char blue = readByteProgmem(aPosition);

  Serial.print("colour is ");
   Serial.print(red, DEC);
   Serial.print(" ");
   Serial.print(green, DEC);
   Serial.print(" ");
   Serial.print(blue, DEC);
   Serial.print("\n");
  unsigned int red12 = pgm_read_word_near(gammaCorrection + red);
  unsigned int green12 = pgm_read_word_near(gammaCorrection + green);
  unsigned int blue12 = pgm_read_word_near(gammaCorrection + blue);

  setColour(aLed, red12, green12, blue12);
}

void setColour(unsigned char aLed, int aRed, int aGreen, int aBlue)
{
  /*Serial.print("setColour ");
   Serial.print(aLed, DEC);
   Serial.print("\n");*/
  // int boardMultiplier = (aLed/16) * 48;
  /*Serial.print("boardMultiplier ");
   Serial.print(boardMultiplier, DEC);
   Serial.print("\n");*/
  Tlc.set(ledMapping[aLed][0], aRed);
  Tlc.set(ledMapping[aLed][1], aGreen);
  Tlc.set(ledMapping[aLed][2], aBlue);
}

unsigned int readByteProgmem(int* aPosition)
{
  // Serial.print("position is (1) ");
  //   Serial.print(*aPosition, DEC);
  // Serial.print("\n");

  unsigned char readByte = pgm_read_byte_near(animation1 + (*(aPosition))++);
  // Serial.print("int is ");
  // Serial.print(integer, DEC);
  //Serial.print("\n");
  //Serial.print("position is (2) ");
  //Serial.print(*aPosition, DEC);
  //Serial.print("\n");

  if(readByte == 0x02) {
    readByte = pgm_read_byte_near(animation1 + (*(aPosition))++);
    //Serial.print("escaped int is ");
    //Serial.print(integer, DEC);
    //Serial.print("\n");
    //Serial.print("position is (3) ");
    // Serial.print(*aPosition, DEC);
    //Serial.print("\n");

    readByte = readByte ^ 0x20;
    //Serial.print("new int is ");
    //Serial.print(integer, DEC);
    //Serial.print("\n");
  }

  return readByte;
}

void hSVtoRGB(int hue, char sat, char val, char* red, char* green, char* blue) {
  RgbColor rgb;
    unsigned char region, remainder, p, q, t;

    if (hsv.s == 0)
    {
        rgb.r = hsv.v;
        rgb.g = hsv.v;
        rgb.b = hsv.v;
        return rgb;
    }

    region = hsv.h / 43;
    remainder = (hsv.h - (region * 43)) * 6; 

    p = (hsv.v * (255 - hsv.s)) >> 8;
    q = (hsv.v * (255 - ((hsv.s * remainder) >> 8))) >> 8;
    t = (hsv.v * (255 - ((hsv.s * (255 - remainder)) >> 8))) >> 8;

    switch (region)
    {
        case 0:
            rgb.r = hsv.v; rgb.g = t; rgb.b = p;
            break;
        case 1:
            rgb.r = q; rgb.g = hsv.v; rgb.b = p;
            break;
        case 2:
            rgb.r = p; rgb.g = hsv.v; rgb.b = t;
            break;
        case 3:
            rgb.r = p; rgb.g = q; rgb.b = hsv.v;
            break;
        case 4:
            rgb.r = t; rgb.g = p; rgb.b = hsv.v;
            break;
        default:
            rgb.r = hsv.v; rgb.g = p; rgb.b = q;
            break;
    }

    return rgb;
}

byte readByteSerial()
{
  int incoming;
  do
  {
    incoming = Serial.read();
    // Serial.print("1:");
    // Serial.print(incoming, HEX);
    //Serial.print("\n");
  }
  while(incoming < 0);

  if(incoming == 0x02)
  {
    do
    {
      incoming = Serial.read();
      // Serial.print("2:");
      // Serial.print(incoming, HEX);
      // Serial.print("\n");
    }
    while(incoming < 0);
    byte incomingbyte = (byte)(incoming) ^ 0x20;
    //  Serial.print("3:");
    //  Serial.print(incomingbyte, HEX);
    // Serial.print("\n");
    return incomingbyte;
  }
  else
  {
    // Serial.print("4:");
    // Serial.print(incoming, HEX);
    //Serial.print("\n");

    return (byte)incoming;
  }
}







